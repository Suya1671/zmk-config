## config/west.yml
```yaml
# This file specifies the build dependencies for Github Action workflows and
# for local build environments. The workspace has three toplevel directories
# containing the user config, user modules and ZMK. Zephyr and its dependencies
# are namespaced under /zmk to keep the toplevel clean.
#
# ZMK-Workspace
# ├── config
# ├── modules (user modules)
# └── zmk
#     └── modules (Zephyr modules)
#
# To create a local build environment, clone this repository and then run the
# following commands from its toplevel directory:
#
# $ west init -l config
# $ west update
# $ west zephyr-export
#
---
manifest:
  defaults:
    remote: urob
    revision: v0.3
  remotes:
    - name: zmkfirmware
      url-base: https://github.com/zmkfirmware
    - name: urob
      url-base: https://github.com/urob
    - name: suya
      url-base: https://github.com/Suya1671
  projects:
    - name: zmk
      remote: zmkfirmware
      import: app/west.yml

    - name: woagboard-zmk
      revision: main
      remote: suya

    - name: zmk-adaptive-key
      path: modules/zmk/adaptive-key
    - name: zmk-auto-layer
      path: modules/zmk/auto-layer
    - name: zmk-helpers
      path: modules/zmk/helpers
    - name: zmk-leader-key
      path: modules/zmk/leader-key
    - name: zmk-tri-state
      path: modules/zmk/tri-state
    - name: zmk-unicode
      path: modules/zmk/unicode

    - name: zephyr
      revision: v3.5.0+zmk-fixes
      clone-depth: 1
      import:
        # Only enable most commonly used boards. For less common hardware one
        # may need to enable additional modules.
        name-allowlist:
          - cmsis
          - hal_nordic
          - hal_rpi_pico
          - hal_stm32
          - lvgl
          - tinycrypt
  self:
    path: config
```
